## boards/arm/hhkb_universal_vault/Kconfig.board
```kconfig
# Le Chiffre (stm32) board configuration

# Copyright (c) 2020 The ZMK Contributors
# SPDX-License-Identifier: MIT

config BOARD_HHKB_UNIVERSAL_VAULT
    bool "HHKB Universal Vault35 (stm32)"
    depends on SOC_STM32F072XB
    
```

## boards/arm/hhkb_universal_vault/Kconfig.defconfig
```kconfig
# Le Chiffre (stm32) board configuration

# Copyright (c) 2020 The ZMK Contributors
# SPDX-License-Identifier: MIT

if BOARD_HHKB_UNIVERSAL_VAULT
config BOARD
    default "hhkb_universal_vault"

config ZMK_KEYBOARD_NAME
    default "Vault35 Alphastagger"

config ZMK_USB
    default y

config ZMK_KSCAN_MATRIX_POLLING
    default y

endif # BOARD_HHKB_UNIVERSAL_VAULT
```
